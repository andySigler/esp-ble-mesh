## sdkconfig.defaults
```kconfig
# Override some defaults

#
# Partitions
#
CONFIG_PARTITION_TABLE_CUSTOM=y
CONFIG_PARTITION_TABLE_CUSTOM_FILENAME="partitions.csv"
CONFIG_PARTITION_TABLE_FILENAME="partitions.csv"

#
# Compiler Optimization
#
CONFIG_COMPILER_OPTIMIZATION_LEVEL_RELEASE=y
CONFIG_OPTIMIZATION_LEVEL_RELEASE=y

#
# Serial flasher config
#
CONFIG_ESPTOOLPY_PORT="/dev/cu.SLAB_USBtoUART"
CONFIG_FLASHMODE_QIO=y
CONFIG_ESPTOOLPY_FLASHMODE_QIO=y
CONFIG_ESPTOOLPY_BAUD_2MB=y
CONFIG_ESPTOOLPY_FLASHFREQ_80M=y

#
# External SPI RAM
#
CONFIG_ESP32_SPIRAM_SUPPORT=y
CONFIG_SPIRAM_USE_CAPS_ALLOC=y
CONFIG_SPIRAM_SPEED_80M=y
CONFIG_SPIRAM_OCCUPY_VSPI_HOST=y
CONFIG_SPIRAM_TRY_ALLOCATE_WIFI_LWIP=y
CONFIG_BT_ALLOCATION_FROM_SPIRAM_FIRST=y
CONFIG_BT_NIMBLE_MEM_ALLOC_MODE_EXTERNAL=y
CONFIG_MBEDTLS_EXTERNAL_MEM_ALLOC=y
CONFIG_WL_SECTOR_SIZE_512=y

#
# ESP32-specific
#
CONFIG_ESP32_DEFAULT_CPU_FREQ_240=y
CONFIG_ESP32_DEFAULT_CPU_FREQ_MHZ=240

#
# FreeRTOS
#
CONFIG_FREERTOS_HZ=100

#
# OTA Rollback
#
CONFIG_BOOTLOADER_APP_ROLLBACK_ENABLE=y

#
# Use Full RF Calibration (adds 100ms to boot, but is recommended)
#
CONFIG_ESP32_PHY_CALIBRATION_AND_DATA_STORAGE=n

#
# Heap Task Debugging (this takes up some DRAM)
#
CONFIG_HEAP_POISONING_LIGHT=n
CONFIG_HEAP_TASK_TRACKING=n

#
# CPU Task Debugging
#
#CONFIG_FREERTOS_USE_TRACE_FACILITY=y
#CONFIG_FREERTOS_GENERATE_RUN_TIME_STATS=y

#
# Bluetooth (A2DP and BLE)
#
CONFIG_BT_ENABLED=y
CONFIG_BTDM_CTRL_PINNED_TO_CORE_0=y
CONFIG_BT_BLUEDROID_PINNED_TO_CORE_0=y
CONFIG_BT_ACL_CONNECTIONS=1
CONFIG_BTDM_CTRL_BLE_MAX_CONN=1
CONFIG_BTDM_CTRL_BLE_MAX_CONN_EFF=1
CONFIG_BTDM_CTRL_MODE_BTDM=y
CONFIG_BTDM_CTRL_HCI_MODE_VHCI=y
CONFIG_BT_BLUEDROID_ENABLED=y
CONFIG_BT_BTU_TASK_STACK_SIZE=8192
CONFIG_BT_BTC_TASK_STACK_SIZE=3072
CONFIG_BT_BLUEDROID_MEM_DEBUG=n
CONFIG_BT_CLASSIC_ENABLED=y
CONFIG_BT_A2DP_ENABLE=y
CONFIG_A2DP_SINK_ENABLE=y
CONFIG_A2DP_SRC_ENABLE=n
CONFIG_BT_GATTS_ENABLE=y
CONFIG_BT_GATTC_ENABLE=n
CONFIG_BT_BLE_SMP_ENABLE=n
CONFIG_BT_SMP_ENABLE=y
CONFIG_BT_SPP_ENABLED=n
CONFIG_BLE_ENABLE_SRVCHG_REG=y
CONFIG_BT_STACK_NO_LOG=y
CONFIG_BT_BLE_DYNAMIC_ENV_MEMORY=y

#
# Flash Size
#
CONFIG_ESPTOOLPY_FLASHSIZE_4MB=y

#
# App Partition Offset
#
# NOTE: not sure if this is needed, because partition table explicitly sets
CONFIG_PARTITION_TABLE_CUSTOM_APP_BIN_OFFSET=0x10000
CONFIG_APP_OFFSET=0x10000

#
# Minimum ESP32 Rev
#
CONFIG_ESP32_REV_MIN_1=y
CONFIG_ESP32_REV_MIN=1

#
# ESP32-Rev1 needs workaround, Rev3 does not
#
CONFIG_SPIRAM_CACHE_WORKAROUND=y
```
